## config/west.yml
```yaml
manifest:
  remotes:
    - name: my_repos
      url-base: https://github.com/RudolfVonKrugstein
    - name: zmkfirmware
      url-base: https://github.com/zmkfirmware
    - name: refil
      url-base: https://github.com/refil
  projects:
    - name: zmk
      remote: refil
      revision: adv360-z3.5
      import: app/west.yml
    - name: kbd_layout
      remote: my_repos
      revision: main
  self:
    path: config
```
